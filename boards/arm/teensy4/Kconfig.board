## boards/arm/teensy4/Kconfig.board
```kconfig
#
# Copyright (c) 2020, Bernhard Kraemer
#
# SPDX-License-Identifier: Apache-2.0
#

config BOARD_TEENSY40
	bool "PJRC TEENSY40"
	depends on SOC_SERIES_IMX_RT
	select SOC_PART_NUMBER_MIMXRT1062DVL6A

config BOARD_TEENSY41
	bool "PJRC TEENSY41"
	depends on SOC_SERIES_IMX_RT
	# correct part no would be MIMXRT1062DVJ6A for TEENSY41, but this type does
	# not exist in zephyr´s SOC definition. MIMXRT1062DVL6A type is used instead
	# as the only difference is package pitch.
	select SOC_PART_NUMBER_MIMXRT1062DVL6A
```

## boards/arm/teensy4/Kconfig.defconfig
```kconfig
#
# Copyright (c) 2020, Bernhard Kraemer
#
# SPDX-License-Identifier: Apache-2.0
#

if BOARD_TEENSY40 || BOARD_TEENSY41

config BUILD_OUTPUT_HEX
    bool
    default y

config BOARD
	default "teensy40" if BOARD_TEENSY40
	default "teensy41" if BOARD_TEENSY41

choice CODE_LOCATION
	default CODE_FLEXSPI
endchoice

config DISK_ACCESS_USDHC1
	default y
	depends on DISK_ACCESS_USDHC

if NETWORKING

config NET_L2_ETHERNET
	default y

config PHY_DP83825
	bool
	default y

endif # NETWORKING

endif # BOARD_TEENSY40 || BOARD_TEENSY41
```

## tests/drivers/spi/spi_loopback/boards/teensy41.conf
```kconfig
#
# Copyright (c) 2018, NXP
# Copyright (c) 2021, Bernhard Kraemer
#
# SPDX-License-Identifier: Apache-2.0
#

CONFIG_SPI_LOOPBACK_DRV_NAME="SPI_3"
```
